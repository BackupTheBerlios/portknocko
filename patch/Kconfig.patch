## patch/Kconfig.patch
```kconfig
*** /usr/src/linux-2.6.16.1/net/ipv4/netfilter/Kconfig	2006-03-28 03:49:02.000000000 -0300
--- Kconfig	2006-04-17 10:19:21.927179328 -0300
***************
*** 313,318 ****
--- 313,326 ----
  
           To compile it as a module, choose M here.  If unsure, say N.
  
+ config IP_NF_MATCH_PKNOCK
+ 	tristate  'Port Knocking match support'
+ 	depends on IP_NF_IPTABLES
+ 	help
+ 	  This option adds a new iptables `pknock' match.  
+ 
+          To compile it as a module, choose M here.  If unsure, say N.
+ 
  # `filter', generic and specific targets
  config IP_NF_FILTER
  	tristate "Packet filtering"
```
